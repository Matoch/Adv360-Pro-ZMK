origin_overlay: origin_overlay {
  label = "origin_overlay";
  compatible = "zmk,behavior-macro";
  #binding-cells = <0>;
  bindings = <&macro_press &kp LSHFT>, <&macro_tap &kp F1>, <&macro_release &kp LSHFT>;
};
ubisoft_overlay: ubisoft_overlay {
  label = "ubisoft_overlay";
  compatible = "zmk,behavior-macro";
  #binding-cells = <0>;
  bindings = <&macro_press &kp LSHFT>, <&macro_tap &kp F2>, <&macro_release &kp LSHFT>;
};
epic_overlay: epic_overlay {
  label = "epic_overlay";
  compatible = "zmk,behavior-macro";
  #binding-cells = <0>;
  bindings = <&macro_press &kp LSHFT>, <&macro_tap &kp F3>, <&macro_release &kp LSHFT>;
};
